## bootloader_components/main/Kconfig.projbuild
```kconfig
menu "Bootloader test options"

config BOOTLOADER_TEST_CRC_FORCE_FAIL
    bool "Force app CRC check to fail (validation testing only)"
    default n
    help
        When enabled, the observed CRC is XOR-inverted before comparison,
        guaranteeing a mismatch regardless of image content.
        Use this to verify that BL_EVT:APP_CRC_FAIL fires and the boot
        path enters recovery hold without handoff.
        Must be disabled for all production and public release builds.

endmenu
```

## main/Kconfig.projbuild
```kconfig
menu "Test app options"

config APP_ENABLE_FAULT_HOOK
    bool "Enable test app fault simulation hook"
    default n
    help
        Enables a controlled reboot simulation hook in the test app.
        Keep disabled for public release builds.

config APP_FAULT_HOOK_GPIO
    int "Fault hook trigger GPIO"
    depends on APP_ENABLE_FAULT_HOOK
    range 0 21
    default 10
    help
        Pull this GPIO low to trigger APP_EVT:FAULT_HOOK:TRIGGERED:RESTART.

endmenu
```

## sdkconfig.defaults
```kconfig
# Bootloader configuration for minimal, non-secure development
# CONFIG_SECURE_BOOT is not set
CONFIG_BOOTLOADER_LOG_LEVEL_ERROR=y
CONFIG_BOOTLOADER_COMPILER_OPTIMIZATION_SIZE=y
CONFIG_PARTITION_TABLE_OFFSET=0x8000
CONFIG_PARTITION_TABLE_CUSTOM=y
CONFIG_PARTITION_TABLE_CUSTOM_FILENAME="partitions.csv"

# (Removed unknown/obsolete Kconfig symbols to match installed ESP-IDF)

# Reduce app log noise during bootloader testing
CONFIG_LOG_DEFAULT_LEVEL_WARN=y

# ESP32-C3 specific - enable USB serial JTAG for console
CONFIG_ESP_CONSOLE_USB_SERIAL_JTAG=y

# Flash size configuration - 4MB onboard flash
CONFIG_ESPTOOLPY_FLASHSIZE_4MB=y
CONFIG_ESPTOOLPY_FLASHSIZE="4MB"
```
